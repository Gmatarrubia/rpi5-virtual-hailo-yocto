## meta-myhome/conf/distro/include/config-file.conf
```bitbake
# Settings set in config.txt file
# This is an important file for tuning RPI

#CMDLINE_DEBUG = "quiet"

DISPMANX_OFFLINE = "1"
DISABLE_OVERSCAN = "1"
DISABLE_RPI_BOOT_LOGO = "1"
DISABLE_SPLASH = "1"

ENABLE_SPI_BUS = "1"
ENABLE_I2C = "1"
ENABLE_UART = "1"
#ENABLE_DWC2_PERIPHERAL = "0"
SERIAL_CONSOLES = "115200;ttyAMA10"

KERNEL_MODULE_AUTOLOAD:rpi += "i2c-dev"

CMDLINE_ROOT_PARTITION = "/dev/sda4"
CMDLINE_ROOT_B_PARTITION = "/dev/sda5"

RPI_EXTRA_CONFIG += "\n\
dtparam=cooling_fan\n\
dtparam=fan_temp0=60000,fan_temp0_hyst=5000,fan_temp0_speed=60\n\
dtparam=fan_temp1=70000,fan_temp1_hyst=5000,fan_temp1_speed=110\n\
dtparam=fan_temp2=77500,fan_temp2_hyst=5000,fan_temp2_speed=175\n\
dtparam=fan_temp3=85000,fan_temp3_hyst=5000,fan_temp3_speed=250\n\
"
```
