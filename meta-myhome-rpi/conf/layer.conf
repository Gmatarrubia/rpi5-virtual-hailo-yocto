## meta-myhome-rpi/conf/layer.conf
```bitbake
# We have a conf and classes directory, append to BBPATH
BBPATH .= ":${LAYERDIR}"

# We have a recipes directory containing .bb and .bbappend files, add to BBFILES
BBFILES += "${LAYERDIR}/recipes*/*/*.bb \
            ${LAYERDIR}/recipes*/*/*.bbappend"

BBFILE_COLLECTIONS += "myhome-rpi"
BBFILE_PATTERN_myhome-rpi := "^${LAYERDIR}/"
BBFILE_PRIORITY_myhome-rpi = "9"

LAYERSERIES_COMPAT_myhome-rpi = "wrynose"
LAYERDEPENDS_myhome-rpi = "raspberrypi"

# Additional license directories.
#LICENSE_PATH += "${LAYERDIR}/files/custom-licenses"
```

## meta-myhome/conf/distro/myhome.conf
```bitbake
require conf/distro/include/config-file.conf
require conf/distro/include/versions.conf

# Distro settings
DISTRO = "myhome"
DISTRO_NAME = "My Home OS (Linux OS based on Poky.)"
DISTRO_VERSION = "1.0"
DISTRO_CODENAME = "wrynose"
MAINTAINER = "Gonzalo Matarrubia"
hostname:pn-base-files = "myhome"

# SDK configs
SDK_VENDOR = "-pokysdk"
SDK_VERSION = "${@d.getVar('DISTRO_VERSION').replace('snapshot-${METADATA_REVISION}', 'snapshot')}"
SDK_VERSION[vardepvalue] = "${SDK_VERSION}"

LINUX_KERNEL_TYPE = "preempt-rt"

# Distro features
DISTRO_FEATURES:remove = "sysvinit x11"
DISTRO_FEATURES:append = " usbhost pam systemd wifi"

# Init manager configs
INIT_MANAGER = "systemd"
VIRTUAL-RUNTIME:init_manager = "systemd"
VIRTUAL-RUNTIME:initscripts = ""

# Miscelanious Configs
IMAGE_LINGUAS = "en-US"

# ROOTFS Size configs
IMAGE_OVERHEAD_FACTOR = "20.0"
# ROOTFS SIZE 10485760 = 10 * 1024 * 1024
ROOTFS_SIZE = "10485760"
```

## meta-myhome/conf/layer.conf
```bitbake
# We have a conf and classes directory, append to BBPATH
BBPATH .= ":${LAYERDIR}"

# We have a recipes directory containing .bb and .bbappend files, add to BBFILES
BBFILES += "${LAYERDIR}/recipes*/*/*.bb \
            ${LAYERDIR}/recipes*/*/*.bbappend"

BBFILE_COLLECTIONS += "myhome"
BBFILE_PATTERN_myhome := "^${LAYERDIR}/"
BBFILE_PRIORITY_myhome = "9"

LAYERSERIES_COMPAT_myhome = "wrynose"

# Additional license directories.
#LICENSE_PATH += "${LAYERDIR}/files/custom-licenses"
```
