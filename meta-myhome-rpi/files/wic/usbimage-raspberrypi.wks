## meta-myhome/conf/distro/include/config-file.conf
```bitbake
# Settings set in config.txt file
# This is an important file for tuning RPI

#CMDLINE_DEBUG = "quiet"

DISPMANX_OFFLINE = "1"
DISABLE_OVERSCAN = "1"
DISABLE_RPI_BOOT_LOGO = "1"
DISABLE_SPLASH = "1"

ENABLE_SPI_BUS = "1"
ENABLE_I2C = "1"
ENABLE_UART = "1"
#ENABLE_DWC2_PERIPHERAL = "0"
SERIAL_CONSOLES = "115200;ttyAMA10"

KERNEL_MODULE_AUTOLOAD:rpi += "i2c-dev"

CMDLINE_ROOT_PARTITION = "/dev/sda4"
CMDLINE_ROOT_B_PARTITION = "/dev/sda5"
```
